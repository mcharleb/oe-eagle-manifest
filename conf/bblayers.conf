## conf/bblayers.conf
```bitbake
# LAYER_CONF_VERSION is increased each time build/conf/bblayers.conf
# changes incompatibly
LCONF_VERSION = "6"
OEROOT := "${@os.path.abspath(os.path.dirname(d.getVar('FILE', True)))}/../.."

BBPATH = "${TOPDIR}"

BBFILES = ""

# These layers hold recipe metadata not found in OE-core, but lack any machine or distro content
BASELAYERS ?= " \
  ${OEROOT}/sources/meta-openembedded/meta-oe \
  ${OEROOT}/sources/meta-openembedded/meta-initramfs \
  ${OEROOT}/sources/meta-openembedded/meta-multimedia \
  ${OEROOT}/sources/meta-openembedded/meta-networking \
  ${OEROOT}/sources/meta-openembedded/meta-webserver \
  ${OEROOT}/sources/meta-openembedded/meta-ruby \
  ${OEROOT}/sources/meta-openembedded/meta-filesystems \
  ${OEROOT}/sources/meta-openembedded/meta-perl \
  ${OEROOT}/sources/meta-openembedded/meta-python \
"

# These layers hold machine specific content, aka Board Support Packages
BSPLAYERS ?= " \
  ${OEROOT}/sources/meta-qcom \
  ${OEROOT}/sources/meta-96boards \
  ${OEROOT}/sources/meta-atlflight \
"

# Add your overlay location to EXTRALAYERS
# Make sure to have a conf/layers.conf in there
EXTRALAYERS ?= " \
  ${OEROOT}/sources/meta-linaro/meta-linaro \
  ${OEROOT}/sources/meta-linaro/meta-linaro-toolchain \
  ${OEROOT}/sources/meta-backports \
"

BBLAYERS = " \
  ${OEROOT}/sources/meta-rpb \
  ${BASELAYERS} \
  ${BSPLAYERS} \
  ${EXTRALAYERS} \
  ${OEROOT}/sources/openembedded-core/meta \
"
```
